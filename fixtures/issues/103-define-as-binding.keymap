/* Issue #103 snippet retained verbatim; AS(Q) remains an opaque binding. */
#define AS(keycode) &as LS(keycode) keycode
/ {
    keymap {
        compatible = "zmk,keymap";
        default_layer { bindings = <AS(Q) &kp A>; };
    };

};
